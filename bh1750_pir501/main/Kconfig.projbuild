## bh1750_pir501/main/Kconfig.projbuild
```kconfig
menu "App Driver Configuration"
    menu "BH1750 configuration"
        choice EXAMPLE_I2C_ADDRESS
            prompt "Select I2C address"
            default EXAMPLE_I2C_ADDRESS_LO
            help
                Select I2C address

            config EXAMPLE_I2C_ADDRESS_LO
                bool "BH1750_ADDR_LO"
                help
                    Choose this when ADDR pin is floating or low.
            config EXAMPLE_I2C_ADDRESS_HI
                bool "BH1750_ADDR_HI"
                help
                    Choose this when ADDR pin is high.
        endchoice

        config EXAMPLE_I2C_MASTER_SCL
            int "SCL GPIO Number"
            default 4 if IDF_TARGET_ESP32H2
            help
                GPIO number for I2C Master clock line.

        config EXAMPLE_I2C_MASTER_SDA
            int "SDA GPIO Number"
            default 5 if IDF_TARGET_ESP32H2
            help
                GPIO number for I2C Master data line.
    endmenu

    menu "PIR Configuration"
        config PIR_DATA_PIN
            int "PIR Data Pin"
            default 25
            help
                Default PIR Data Pin
    endmenu
endmenu
```

## fan_dht22/main/Kconfig.projbuild
```kconfig
menu "App Driver Configuration"
menu "Fan driver configuration"
    config BLDC_PWM_GPIO
            int "BLDC PWM GPIO"
            default 5
            help
                GPIO to use for BLDC PWM signal.
endmenu
endmenu
```

## fan_dht22/sdkconfig.defaults.esp32h2
```kconfig
CONFIG_IDF_TARGET="esp32h2"
CONFIG_ESP_CONSOLE_USB_SERIAL_JTAG=y

# libsodium
CONFIG_LIBSODIUM_USE_MBEDTLS_SHA=y

# NIMBLE
CONFIG_BT_ENABLED=y
CONFIG_BT_NIMBLE_ENABLED=y
CONFIG_BT_NIMBLE_EXT_ADV=n
CONFIG_BT_NIMBLE_HCI_EVT_BUF_SIZE=70
CONFIG_USE_BLE_ONLY_FOR_COMMISSIONING=n

# FreeRTOS should use legacy API
CONFIG_FREERTOS_ENABLE_BACKWARD_COMPATIBILITY=y

# Enable OpenThread
CONFIG_OPENTHREAD_ENABLED=y
CONFIG_OPENTHREAD_SRP_CLIENT=y
CONFIG_OPENTHREAD_DNS_CLIENT=y
CONFIG_OPENTHREAD_LOG_LEVEL_DYNAMIC=n
CONFIG_OPENTHREAD_LOG_LEVEL_NOTE=y
CONFIG_OPENTHREAD_CLI=n


# Disable lwip ipv6 autoconfig
CONFIG_LWIP_IPV6_AUTOCONFIG=n

# Use a custom partition table
CONFIG_PARTITION_TABLE_CUSTOM=y
CONFIG_PARTITION_TABLE_CUSTOM_FILENAME="partitions.csv"

# LwIP config for OpenThread
CONFIG_LWIP_IPV6_NUM_ADDRESSES=8
CONFIG_LWIP_MULTICAST_PING=y

# MDNS platform
CONFIG_USE_MINIMAL_MDNS=n
CONFIG_ENABLE_EXTENDED_DISCOVERY=y

# Enable OTA Requestor
CONFIG_ENABLE_OTA_REQUESTOR=y

# Disable STA and AP for ESP32H2
CONFIG_ENABLE_WIFI_STATION=n
CONFIG_ENABLE_WIFI_AP=n

# Enable chip shell
CONFIG_ENABLE_CHIP_SHELL=y

# Enable DS Peripheral
CONFIG_ESP_SECURE_CERT_DS_PERIPHERAL=y

# Disable persist subscriptions
CONFIG_ENABLE_PERSIST_SUBSCRIPTIONS=n

# MRP configs
CONFIG_MRP_LOCAL_ACTIVE_RETRY_INTERVAL_FOR_THREAD=5000
CONFIG_MRP_LOCAL_IDLE_RETRY_INTERVAL_FOR_THREAD=5000
CONFIG_MRP_RETRY_INTERVAL_SENDER_BOOST_FOR_THREAD=5000
CONFIG_MRP_MAX_RETRANS=3

#######################
# ESP32-H2-DevKitM-1 Settings
# Buttons
CONFIG_BSP_BUTTONS_NUM=1
CONFIG_BSP_BUTTON_1_TYPE_GPIO=y
CONFIG_BSP_BUTTON_1_GPIO=9
CONFIG_BSP_BUTTON_1_LEVEL=0

# Button
CONFIG_BUTTON_PERIOD_TIME_MS=20
CONFIG_BUTTON_LONG_PRESS_TIME_MS=5000

# Enable DS Peripheral
CONFIG_ESP_SECURE_CERT_DS_PERIPHERAL=y

# Use DAC Provider implementation which reads attestation data from secure cert partition
CONFIG_SEC_CERT_DAC_PROVIDER=y

# Enable some options which reads CD and other basic info from the factory partition
CONFIG_ENABLE_ESP32_FACTORY_DATA_PROVIDER=y
CONFIG_ENABLE_ESP32_DEVICE_INSTANCE_INFO_PROVIDER=y
CONFIG_FACTORY_COMMISSIONABLE_DATA_PROVIDER=y
CONFIG_FACTORY_DEVICE_INSTANCE_INFO_PROVIDER=y
```
